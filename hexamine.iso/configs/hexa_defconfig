## hexamine.iso/configs/hexa_defconfig
```kconfig
BR2_i386=y
BR2_x86_pentiumpro=y
BR2_CCACHE=y
BR2_TARGET_GENERIC_HOSTNAME="hexamine.org"
BR2_TARGET_GENERIC_ISSUE="Welcome to hexamine.org"
BR2_ROOTFS_OVERLAY="$(BR2_EXTERNAL_hexa_PATH)/board/hexa/rootfs_overlay/"
BR2_LINUX_KERNEL=y
BR2_LINUX_KERNEL_USE_CUSTOM_CONFIG=y
BR2_LINUX_KERNEL_CUSTOM_CONFIG_FILE="$(BR2_EXTERNAL_hexa_PATH)/board/hexa/linux.config"
BR2_LINUX_KERNEL_LZO=y
BR2_TARGET_ROOTFS_INITRAMFS=y
BR2_TARGET_ROOTFS_ISO9660=y
BR2_TARGET_SYSLINUX=y
```
